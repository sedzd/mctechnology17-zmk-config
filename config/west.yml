## config/west.yml
```yaml
manifest:
  remotes:
    - name: zmkfirmware
      url-base: https://github.com/zmkfirmware
    # nice_view_gem
    - name: m165437
      url-base: https://github.com/M165437
    # nice_oled - nice_epaper
    - name: mctechnology17
      url-base: https://github.com/mctechnology17
    # urob modules (auto-layer, tri-state)
    - name: urob
      url-base: https://github.com/urob
  projects:
    - name: zmk
      remote: zmkfirmware
      revision: v0.3.0
      import: app/west.yml
    # nice_view_gem
    - name: nice-view-gem
      remote: m165437
      revision: main
    # nice_oled - nice_epaper
    - name: zmk-nice-oled
      remote: mctechnology17
      revision: main
    # urob's zmk-auto-layer
    - name: zmk-auto-layer
      remote: urob
      revision: main
    # urob's zmk-tri-state
    - name: zmk-tri-state
      remote: urob
      revision: main
  self:
    path: config
```
